## configs/smartlabs_sml_hi3798mv200_defconfig
```kconfig
BR2_arm=y
BR2_cortex_a53=y
BR2_CCACHE=y
BR2_CCACHE_DIR="/var/.ccache"
BR2_TOOLCHAIN_EXTERNAL=y
BR2_TOOLCHAIN_EXTERNAL_CUSTOM=y
BR2_TOOLCHAIN_EXTERNAL_PATH="/opt/toolchains/arm-histbv320-gcc-4.9.4-glibc-2.27"
BR2_TOOLCHAIN_EXTERNAL_GCC_4_9=y
BR2_TOOLCHAIN_EXTERNAL_HEADERS_4_6=y
BR2_TOOLCHAIN_EXTERNAL_CUSTOM_GLIBC=y
BR2_TOOLCHAIN_EXTERNAL_CXX=y
BR2_TARGET_GENERIC_ROOT_PASSWD="f2line.."
BR2_ROOTFS_USERS_TABLES="board/smartlabs/sml_hi3798mv200/users_table.txt"
BR2_ROOTFS_OVERLAY="board/smartlabs/sml_hi3798mv200/rootfs-overlay"
BR2_ROOTFS_POST_BUILD_SCRIPT="board/smartlabs/sml_hi3798mv200/post_build.sh"
BR2_PACKAGE_BUSYBOX_CONFIG_FRAGMENT_FILES="board/smartlabs/sml_hi3798mv200/busybox.config.part"
BR2_PACKAGE_STRACE=y
BR2_PACKAGE_PYTHON3=y
BR2_PACKAGE_PYTHON3_BZIP2=y
BR2_PACKAGE_PYTHON3_CODECSCJK=y
BR2_PACKAGE_PYTHON3_CURSES=y
BR2_PACKAGE_PYTHON3_DECIMAL=y
BR2_PACKAGE_PYTHON3_OSSAUDIODEV=y
BR2_PACKAGE_PYTHON3_READLINE=y
BR2_PACKAGE_PYTHON3_SQLITE=y
BR2_PACKAGE_PYTHON3_XZ=y
BR2_PACKAGE_PYTHON_AWESOME_SLUGIFY=y
BR2_PACKAGE_PYTHON_BLINKER=y
BR2_PACKAGE_PYTHON_CACHELIB=y
BR2_PACKAGE_PYTHON_EMOJI=y
BR2_PACKAGE_PYTHON_FEEDPARSER=y
BR2_PACKAGE_PYTHON_FILETYPE=y
BR2_PACKAGE_PYTHON_FLASK_ASSETS=y
BR2_PACKAGE_PYTHON_FLASK_BABEL=y
BR2_PACKAGE_PYTHON_FLASK_LOGIN=y
BR2_PACKAGE_PYTHON_FROZENDICT=y
BR2_PACKAGE_PYTHON_MARKDOWN=y
BR2_PACKAGE_PYTHON_NETADDR=y
BR2_PACKAGE_PYTHON_NETIFACES=y
BR2_PACKAGE_PYTHON_PIP=y
BR2_PACKAGE_PYTHON_PSUTIL=y
BR2_PACKAGE_PYTHON_PYASN=y
BR2_PACKAGE_PYTHON_PYLRU=y
BR2_PACKAGE_PYTHON_REGEX=y
BR2_PACKAGE_PYTHON_REQUESTS=y
BR2_PACKAGE_PYTHON_RSA=y
BR2_PACKAGE_PYTHON_SARGE=y
BR2_PACKAGE_PYTHON_SEMVER=y
BR2_PACKAGE_PYTHON_SENTRY_SDK=y
BR2_PACKAGE_PYTHON_SERIAL=y
BR2_PACKAGE_PYTHON_TORNADO=y
BR2_PACKAGE_PYTHON_WATCHDOG=y
BR2_PACKAGE_PYTHON_WEBSOCKET_CLIENT=y
BR2_PACKAGE_PYTHON_WRAPT=y
BR2_PACKAGE_CA_CERTIFICATES=y
BR2_PACKAGE_BERKELEYDB=y
BR2_PACKAGE_DHCPCD=y
BR2_PACKAGE_DROPBEAR=y
BR2_PACKAGE_NTP=y
BR2_PACKAGE_WIRELESS_TOOLS=y
BR2_PACKAGE_WIRELESS_TOOLS_LIB=y
BR2_PACKAGE_WPA_SUPPLICANT=y
BR2_PACKAGE_WPA_SUPPLICANT_AUTOSCAN=y
BR2_PACKAGE_WPA_SUPPLICANT_DEBUG_SYSLOG=y
BR2_PACKAGE_WPA_SUPPLICANT_CLI=y
BR2_PACKAGE_SCREEN=y
BR2_PACKAGE_SUDO=y
BR2_PACKAGE_KMOD=y
BR2_PACKAGE_NANO=y
BR2_TARGET_ROOTFS_SQUASHFS=y
# BR2_TARGET_ROOTFS_TAR is not set
```

## package/python-awesome-slugify/Config.in
```kconfig
config BR2_PACKAGE_PYTHON_AWESOME_SLUGIFY
	bool "python-awesome-slugify"
	help
	  Python flexible slugify function

	  https://github.com/dimka665/awesome-slugify
```

## package/python-frozendict/Config.in
```kconfig
config BR2_PACKAGE_PYTHON_FROZENDICT
	bool "python-frozendict"
	help
	  Python HTTP library with thread-safe connection pooling, file
	  post support, sanity friendly, and more.

	  https://github.com/slezica/python-frozendict
```

## package/python-regex/Config.in
```kconfig
config BR2_PACKAGE_PYTHON_REGEX
	bool "python-regex"
	help
      This regex implementation is backwards-compatible with
      the standard 're' module, but offers additional functionality.

	  https://bitbucket.org/mrabarnett/mrab-regex
```

## package/python-rsa/Config.in
```kconfig
config BR2_PACKAGE_PYTHON_RSA
	bool "python-rsa"
	help
	  Pure-Python RSA implementation

	  https://stuvel.eu/rsa
```

## package/python-sarge/Config.in
```kconfig
config BR2_PACKAGE_PYTHON_SARGE
	bool "python-sarge"
	help
	  A wrapper for subprocess which provides command pipeline functionality.

	  http://sarge.readthedocs.org/
```

## package/python-webassets/Config.in
```kconfig
config BR2_PACKAGE_PYTHON_WEBASSETS
	bool "python-webassets"
	help
	  Media asset management for Python, with glue code for various web frameworks

	  https://github.com/miracle2k/webassets/
```
